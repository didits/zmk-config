## config/boards/shields/macropad2/Kconfig.defconfig
```kconfig
if SHIELD_MACROPAD2

config ZMK_KEYBOARD_NAME
    default "macropad2"

config ZMK_KSCAN_DEBOUNCE_PRESS_MS
    default 5

config ZMK_KSCAN_DEBOUNCE_RELEASE_MS
    default 5

endif
```
